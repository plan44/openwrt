## omega4_defconfig
```kconfig
CONFIG_TARGET_rockchip=y
CONFIG_TARGET_rockchip_cortexa7=y
CONFIG_TARGET_rockchip_cortexa7_DEVICE_onion_omega4-evb=y
CONFIG_DEVEL=y
CONFIG_BUSYBOX_CUSTOM=y
CONFIG_BUSYBOX_CONFIG_DEVMEM=y
CONFIG_EXTERNAL_KERNEL_TREE=""
CONFIG_KERNEL_CFLAGS="-Wno-error"
CONFIG_KERNEL_DEVMEM=y
CONFIG_PACKAGE_MAC80211_DEBUGFS=y
CONFIG_PACKAGE_MAC80211_MESH=y
CONFIG_PACKAGE_aic8800d-firmware=y
CONFIG_PACKAGE_awgctl=y
CONFIG_PACKAGE_bluez-daemon=y
CONFIG_PACKAGE_bluez-libs=y
CONFIG_PACKAGE_bluez-tools=y
CONFIG_PACKAGE_bluez-utils=y
CONFIG_PACKAGE_bluez-utils-btmon=y
CONFIG_PACKAGE_bluez-utils-extra=y
CONFIG_PACKAGE_dbus=y
CONFIG_PACKAGE_glib2=y
CONFIG_PACKAGE_hostapd-common=y
CONFIG_PACKAGE_iw=y
CONFIG_PACKAGE_iwinfo=y
CONFIG_PACKAGE_kmod-6lowpan=y
CONFIG_PACKAGE_kmod-aic8800d-sdio=y
CONFIG_PACKAGE_kmod-bluetooth=y
CONFIG_PACKAGE_kmod-bluetooth-6lowpan=y
CONFIG_PACKAGE_kmod-cfg80211=y
CONFIG_PACKAGE_kmod-crypto-aead=y
CONFIG_PACKAGE_kmod-crypto-ccm=y
CONFIG_PACKAGE_kmod-crypto-cmac=y
CONFIG_PACKAGE_kmod-crypto-ctr=y
CONFIG_PACKAGE_kmod-crypto-ecb=y
CONFIG_PACKAGE_kmod-crypto-ecdh=y
CONFIG_PACKAGE_kmod-crypto-gcm=y
CONFIG_PACKAGE_kmod-crypto-geniv=y
CONFIG_PACKAGE_kmod-crypto-gf128=y
CONFIG_PACKAGE_kmod-crypto-ghash=y
CONFIG_PACKAGE_kmod-crypto-hmac=y
CONFIG_PACKAGE_kmod-crypto-kpp=y
CONFIG_PACKAGE_kmod-crypto-manager=y
CONFIG_PACKAGE_kmod-crypto-null=y
CONFIG_PACKAGE_kmod-crypto-rng=y
CONFIG_PACKAGE_kmod-crypto-seqiv=y
CONFIG_PACKAGE_kmod-crypto-sha3=y
CONFIG_PACKAGE_kmod-crypto-sha512=y
CONFIG_PACKAGE_kmod-hid=y
CONFIG_PACKAGE_kmod-input-core=y
CONFIG_PACKAGE_kmod-input-evdev=y
CONFIG_PACKAGE_kmod-lib-crc16=y
CONFIG_PACKAGE_kmod-mac80211=y
CONFIG_PACKAGE_kmod-mmc=y
CONFIG_PACKAGE_kmod-nls-base=y
CONFIG_PACKAGE_kmod-regmap-core=y
CONFIG_PACKAGE_kmod-rockchip-awg=y
CONFIG_PACKAGE_kmod-usb-core=y
CONFIG_PACKAGE_libattr=y
CONFIG_PACKAGE_libdbus=y
CONFIG_PACKAGE_libexpat=y
CONFIG_PACKAGE_libffi=y
CONFIG_PACKAGE_libical=y
CONFIG_PACKAGE_libiwinfo=y
CONFIG_PACKAGE_libiwinfo-data=y
CONFIG_PACKAGE_libncurses=y
CONFIG_PACKAGE_libpcre2=y
CONFIG_PACKAGE_libreadline=y
CONFIG_PACKAGE_omega4-pinmux=y
CONFIG_PACKAGE_terminfo=y
CONFIG_PACKAGE_ucode-mod-nl80211=y
CONFIG_PACKAGE_ucode-mod-rtnl=y
CONFIG_PACKAGE_ucode-mod-uloop=y
CONFIG_PACKAGE_wifi-scripts=y
CONFIG_PACKAGE_wireless-regdb=y
CONFIG_PACKAGE_wpad-basic-mbedtls=y
CONFIG_PACKAGE_zlib=y
CONFIG_PCRE2_JIT_ENABLED=y
CONFIG_WPA_MBO_SUPPORT=y
CONFIG_WPA_MSG_MIN_PRIORITY=3
```

## target/linux/rockchip/image/boot-arm-nand-tb.its
```
/*
 * Copyright (C) 2021 Rockchip Electronics Co., Ltd
 *
 * SPDX-License-Identifier: GPL-2.0
 *
 * For Thunderboot (TB) SPI NAND builds where the rkbin NAND SPL loads the
 * kernel directly. The SPL uses SDRAM 0x0-0x1fffff for its stack/heap, so
 * the kernel must be placed at 0x208000 (above the SPL region). The SPL
 * resolves FDT_ADDR_PLACEHOLDER (0xffffff00) but not KERNEL_ADDR_PLACEHOLDER
 * (0xffffff01), so kernel load/entry must be a real address.
 */

/dts-v1/;
/ {
    description = "FIT image with Linux kernel, FDT blob and resource (NAND TB)";

    images {
        fdt {
            data = /incbin/("fdt");
            type = "flat_dt";
            arch = "arm";
            compression = "none";
            load = <0xffffff00>;

            hash {
                algo = "sha256";
                uboot-ignore = <1>;
            };
        };

        kernel {
            data = /incbin/("kernel");
            type = "kernel";
            arch = "arm";
            os = "linux";
            compression = "none";
            entry = <0x00208000>;
            load = <0x00208000>;

            hash {
                algo = "sha256";
                uboot-ignore = <1>;
            };
        };

        resource {
            data = /incbin/("resource");
            type = "multi";
            arch = "arm";
            compression = "none";

            hash {
                algo = "sha256";
                uboot-ignore = <1>;
            };
        };
    };

    configurations {
        default = "conf";

        conf {
            rollback-index = <0x00>;
            fdt = "fdt";
            kernel = "kernel";
            multi = "resource";

            signature {
                algo = "sha256,rsa2048";
                padding = "pss";
                key-name-hint = "dev";
                sign-images = "fdt", "kernel", "multi";
            };
        };
    };
};
```
